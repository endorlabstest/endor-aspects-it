load("@build_bazel_rules_swift//swift:swift_library.bzl", "swift_library")

objc_library(
    name = "CSystem",
    srcs = ["Sources/CSystem/shims.c"],
    hdrs = glob(["Sources/CSystem/include/*.h"]),
    includes = ["Sources/CSystem/include"],
    visibility = ["//visibility:public"],
)

swift_library(
    name = "SystemPackage",
    srcs = glob(["Sources/System/**/*.swift"]),
    module_name = "SystemPackage",
    visibility = ["//visibility:public"],
    deps = [":CSystem"],
)
