load("@build_bazel_rules_swift//swift:swift_library.bzl", "swift_library")

# swift-nio 2.95.0 uses Swift's `package` access modifier, which requires
# -package-name to be set at compile time.
_NIO_PACKAGE_COPTS = [
    "-package-name",
    "swift-nio",
    "-enable-experimental-feature",
    "Lifetimes",
]

objc_library(
    name = "CNIOAtomics",
    srcs = glob([
        "Sources/CNIOAtomics/src/*.c",
        "Sources/CNIOAtomics/src/*.h",
    ]),
    hdrs = glob(["Sources/CNIOAtomics/include/*.h"]),
    copts = ["-D_GNU_SOURCE"],
    includes = ["Sources/CNIOAtomics/include"],
    visibility = ["//visibility:public"],
)

objc_library(
    name = "CNIODarwin",
    srcs = ["Sources/CNIODarwin/shim.c"],
    hdrs = glob(["Sources/CNIODarwin/include/*.h"]),
    copts = ["-D__APPLE_USE_RFC_3542"],
    includes = ["Sources/CNIODarwin/include"],
    visibility = ["//visibility:public"],
)

objc_library(
    name = "CNIOLinux",
    srcs = glob(["Sources/CNIOLinux/*.c"]),
    hdrs = glob(["Sources/CNIOLinux/include/*.h"]),
    copts = ["-D_GNU_SOURCE"],
    includes = ["Sources/CNIOLinux/include"],
    visibility = ["//visibility:public"],
)

objc_library(
    name = "CNIOOpenBSD",
    srcs = ["Sources/CNIOOpenBSD/shim.c"],
    hdrs = glob(["Sources/CNIOOpenBSD/include/*.h"]),
    includes = ["Sources/CNIOOpenBSD/include"],
    visibility = ["//visibility:public"],
)

objc_library(
    name = "CNIOLLHTTP",
    srcs = glob(["Sources/CNIOLLHTTP/*.c"]),
    hdrs = glob(["Sources/CNIOLLHTTP/include/*.h"]),
    copts = [
        "-D_GNU_SOURCE",
        "-DLLHTTP_STRICT_MODE",
    ],
    includes = ["Sources/CNIOLLHTTP/include"],
    visibility = ["//visibility:public"],
)

objc_library(
    name = "CNIOPosix",
    srcs = ["Sources/CNIOPosix/event_loop_id.c"],
    hdrs = glob(["Sources/CNIOPosix/include/*.h"]),
    copts = ["-D_GNU_SOURCE"],
    includes = ["Sources/CNIOPosix/include"],
    visibility = ["//visibility:public"],
)

objc_library(
    name = "CNIOWindows",
    srcs = glob(["Sources/CNIOWindows/*.c"]),
    hdrs = glob(["Sources/CNIOWindows/include/*.h"]),
    includes = ["Sources/CNIOWindows/include"],
    visibility = ["//visibility:public"],
)

objc_library(
    name = "CNIOWASI",
    srcs = glob(["Sources/CNIOWASI/*.c"]),
    hdrs = glob(["Sources/CNIOWASI/include/*.h"]),
    includes = ["Sources/CNIOWASI/include"],
    visibility = ["//visibility:public"],
)

swift_library(
    name = "_NIOBase64",
    srcs = glob(["Sources/_NIOBase64/**/*.swift"]),
    copts = _NIO_PACKAGE_COPTS,
    module_name = "_NIOBase64",
    visibility = ["//visibility:public"],
)

swift_library(
    name = "_NIODataStructures",
    srcs = glob(["Sources/_NIODataStructures/**/*.swift"]),
    copts = _NIO_PACKAGE_COPTS,
    module_name = "_NIODataStructures",
    visibility = ["//visibility:public"],
)

swift_library(
    name = "NIOConcurrencyHelpers",
    srcs = glob(["Sources/NIOConcurrencyHelpers/**/*.swift"]),
    copts = _NIO_PACKAGE_COPTS,
    module_name = "NIOConcurrencyHelpers",
    visibility = ["//visibility:public"],
    deps = [":CNIOAtomics"],
)

swift_library(
    name = "NIOCore",
    srcs = glob(["Sources/NIOCore/**/*.swift"]),
    copts = _NIO_PACKAGE_COPTS,
    module_name = "NIOCore",
    visibility = ["//visibility:public"],
    deps = [
        ":_NIOBase64",
        ":_NIODataStructures",
        ":CNIOAtomics",
        ":CNIODarwin",
        ":CNIOLinux",
        ":CNIOOpenBSD",
        ":CNIOWindows",
        ":CNIOWASI",
        ":NIOConcurrencyHelpers",
        "@swift_atomics//:Atomics",
        "@swift_collections//:DequeModule",
    ],
)

swift_library(
    name = "NIOEmbedded",
    srcs = glob(["Sources/NIOEmbedded/**/*.swift"]),
    copts = _NIO_PACKAGE_COPTS,
    module_name = "NIOEmbedded",
    visibility = ["//visibility:public"],
    deps = [
        ":_NIODataStructures",
        ":NIOConcurrencyHelpers",
        ":NIOCore",
        "@swift_atomics//:Atomics",
        "@swift_collections//:DequeModule",
    ],
)

swift_library(
    name = "NIOPosix",
    srcs = glob(
        ["Sources/NIOPosix/**/*.swift"],
        exclude = ["Sources/NIOPosix/PrivacyInfo.xcprivacy"],
    ),
    copts = _NIO_PACKAGE_COPTS,
    module_name = "NIOPosix",
    visibility = ["//visibility:public"],
    deps = [
        ":_NIODataStructures",
        ":CNIOAtomics",
        ":CNIODarwin",
        ":CNIOLinux",
        ":CNIOOpenBSD",
        ":CNIOPosix",
        ":CNIOWindows",
        ":NIOConcurrencyHelpers",
        ":NIOCore",
        "@swift_atomics//:Atomics",
    ],
)

swift_library(
    name = "NIO",
    srcs = glob(["Sources/NIO/**/*.swift"]),
    copts = _NIO_PACKAGE_COPTS,
    module_name = "NIO",
    visibility = ["//visibility:public"],
    deps = [
        ":NIOCore",
        ":NIOEmbedded",
        ":NIOPosix",
    ],
)

swift_library(
    name = "NIOHTTP1",
    srcs = glob(["Sources/NIOHTTP1/**/*.swift"]),
    copts = _NIO_PACKAGE_COPTS,
    module_name = "NIOHTTP1",
    visibility = ["//visibility:public"],
    deps = [
        ":_NIOBase64",
        ":CNIOLLHTTP",
        ":NIO",
        ":NIOConcurrencyHelpers",
        ":NIOCore",
        "@swift_collections//:DequeModule",
    ],
)

swift_library(
    name = "NIOTLS",
    srcs = glob(["Sources/NIOTLS/**/*.swift"]),
    copts = _NIO_PACKAGE_COPTS,
    module_name = "NIOTLS",
    visibility = ["//visibility:public"],
    deps = [
        ":NIO",
        ":NIOCore",
        "@swift_collections//:DequeModule",
    ],
)
